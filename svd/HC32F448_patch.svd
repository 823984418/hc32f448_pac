# HC32F448 register map
File version: 1.0
CPU: CM4 r0p1, little endian, MPU, FPU, 4 interrupt priority bits
Registers are 32-bit, read-write, reset 0x0 unless marked. A register's access mark holds for its fields unless they carry their own. Offsets are from the block's base; lines under a group give offsets from that group; [hi:lo] are bit positions; {n}, {i} and the like mark numbered series; 'fields as' and 'values as' point back to an identical list; <NAME> marks a mode.

## Memory map
0x00000400 ICG size 0x14
0x40008000 AES size 0x40
0x40008400 HASH size 0x80
0x40008C00 CRC size 0x100
0x40010400 EFM size 0x194
0x40010800 AOS size 0x250
0x40017C00 EMB0 size 0x1C
0x40017C20 EMB1 size 0x3C — desc EMB
0x40017C40 EMB2 size 0x3C — desc EMB
0x40017C60 EMB3 size 0x3C — desc EMB
0x4001C000 SPI1 size 0x1C — desc SPI
0x4001C400 SPI2 size 0x1C — desc SPI
0x4001CC00 USART1 size 0x1C — desc USART
0x4001D000 USART2 size 0x1C — desc USART
0x4001D400 USART3 size 0x20 — desc USART
0x40020000 SPI3 size 0x1C — desc SPI
0x40020C00 USART4 size 0x1C — desc USART
0x40021000 USART5 size 0x1C — desc USART
0x40021400 USART6 size 0x20 — desc USART
0x40024000 TMR01 size 0x18 — desc TMR0
0x40024400 TMR02 size 0x18 — desc TMR0
0x40026000 TMRA5 size 0x15E — desc TMRA
0x40029000 MCAN1 size 0xFC — desc MCAN
0x40029400 MCAN2 size 0xFC — desc MCAN
0x40038000 TMR41 size 0xFE
0x40038400 TMR42 size 0xFE
0x40038800 CMP1 size 0x20
0x40038900 CMP2 size 0x20
0x40038C00 CMP3 size 0x20
0x40038D00 CMP4 size 0x20
0x40038E00 TMR43 size 0xFE
0x4003A000 TMRA1 size 0x15E — desc TMRA
0x4003A400 TMRA2 size 0x15E — desc TMRA
0x4003A800 TMRA3 size 0x15E — desc TMRA
0x4003AC00 TMRA4 size 0x15E — desc TMRA
0x4003B400 I2C1 size 0x3C — desc I2C
0x4003B800 I2C2 size 0x3C — desc I2C
0x4003C000 TMR61 size 0x1A0 — desc TMR6
0x4003C300 TMR6_COMMON size 0x100
0x4003C400 TMR62 size 0x1A0 — desc TMR6
0x40040000 ADC1 size 0xB1
0x40040400 ADC2 size 0xB1
0x40040800 ADC3 size 0xB1
0x40041000 DAC size 0x1E
0x40042000 TRNG size 0x14
0x40048000 CMU size 0xC104
0x40048000 PWC size 0xC400
0x40048400 FCM size 0x24
0x40049000 WDT size 0xC
0x40049400 SWDT size 0xC
0x40049C00 CTC size 0xE
0x4004C000 RTC size 0x3D
0x4004CCE0 RMU size 0x18
0x40050000 MPU size 0x80
0x40050800 SRAMC size 0x34
0x40050C00 KEYSCAN size 0xC
0x40051000 INTC size 0xE8
0x40053000 DMA1 size 0x1B8 — desc DMA
0x40053400 DMA2 size 0x1B8 — desc DMA
0x40053800 GPIO size 0x54C
0x40055400 PERIC size 0x20
0x40056000 DCU1 size 0x1C — desc DCU
0x40056400 DCU2 size 0x1C — desc DCU
0x40056800 DCU3 size 0x1C — desc DCU
0x40056C00 DCU4 size 0x1C — desc DCU
0x88000000 SMC size 0x210
0x9C000000 QSPI size 0x808
0xE0042000 DBGC size 0x2C

## Interrupts
{n} IRQ{n:03}_Handler (INTC) (n=0..15)
{n+16} EXTINT{n:02}_SWINT{n+16}_Handler (INTC) (n=0..15)
32 DMA1_Error_Handler (DMA1)
33 DMA1_TC0_BTC0_Handler (DMA1)
34 DMA1_TC1_BTC1_Handler (DMA1)
35 DMA1_TC2_BTC2_Handler (DMA1)
36 DMA1_TC3_BTC3_Handler (DMA1)
37 DMA1_TC4_BTC4_Handler (DMA1)
38 DMA1_TC5_BTC5_Handler (DMA1)
39 EFM_PEError_ReadCol_Handler (EFM)
40 EFM_OpEnd_Handler (EFM)
41 QSPI_Handler (QSPI)
42 DCU1_Handler (DCU1)
43 DCU2_Handler (DCU1)
44 DCU3_Handler (DCU1)
45 DCU4_Handler (DCU1)
46 DMA2_Error_Handler (DMA2)
47 DMA2_TC0_BTC0_Handler (DMA2)
48 DMA2_TC1_BTC1_Handler (DMA2)
49 DMA2_TC2_BTC2_Handler (DMA2)
50 DMA2_TC3_BTC3_Handler (DMA2)
51 DMA2_TC4_BTC4_Handler (DMA2)
52 DMA2_TC5_BTC5_Handler (DMA2)
53 TMR0_1_Handler (TMR01)
54 TMR0_2_Handler (TMR02)
55 RTC_Handler (RTC)
56 CLK_XtalStop_Handler (CMU)
57 PWC_WKTM_Handler (PWC)
58 SWDT_Handler (SWDT)
59 TMR6_1_GCmp_Handler (TMR61)
60 TMR6_1_Ovf_Udf_Handler (TMR61)
61 TMR6_1_Dte_Handler (TMR61)
62 TMR6_1_SCmp_Handler (TMR61)
63 TMRA_1_Ovf_Udf_Handler (TMRA1)
64 TMRA_1_Cmp_Handler (TMRA1)
65 TMR6_2_GCmp_Handler (TMR62)
66 TMR6_2_Ovf_Udf_Handler (TMR62)
67 TMR6_2_Dte_Handler (TMR62)
68 TMR6_2_SCmp_Handler (TMR62)
69 TMRA_2_Ovf_Udf_Handler (TMRA2)
70 TMRA_2_Cmp_Handler (TMRA2)
71 TMRA_3_Ovf_Udf_Handler (TMRA3)
72 TMRA_3_Cmp_Handler (TMRA3)
73 TMRA_4_Ovf_Udf_Handler (TMRA4)
74 TMRA_4_Cmp_Handler (TMRA4)
75 TMR4_1_GCmp_Handler (TMR41)
76 TMR4_1_Ovf_Udf_Handler (TMR41)
77 TMR4_1_Reload_Handler (TMR41)
78 TMR4_1_SCmp_Handler (TMR41)
79 TMR4_2_GCmp_Handler (TMR42)
80 TMR4_2_Ovf_Udf_Handler (TMR42)
81 TMR4_2_Reload_Handler (TMR42)
82 TMR4_2_SCmp_Handler (TMR42)
83 TMR4_3_GCmp_Handler (TMR43)
84 TMR4_3_Ovf_Udf_Handler (TMR43)
85 TMR4_3_Reload_Handler (TMR43)
86 TMR4_3_SCmp_Handler (TMR43)
87 I2C1_Handler (I2C1)
88 I2C2_Handler (I2C2)
89 CMP1_Handler (CMP1)
90 CMP2_Handler (CMP2)
91 CMP3_Handler (CMP3)
92 CMP4_Handler (CMP4)
93 USART1_Handler (USART1)
94 USART1_TxComplete_Handler (USART1)
95 USART2_Handler (USART2)
96 USART2_TxComplete_Handler (USART2)
97 SPI1_Handler (SPI1)
98 TMRA_5_Ovf_Udf_Handler (TMRA5)
99 TMRA_5_Cmp_Handler (TMRA5)
100 EVENT_PORT1_Handler (INTC)
101 EVENT_PORT2_Handler (INTC)
102 EVENT_PORT3_Handler (INTC)
103 EVENT_PORT4_Handler (INTC)
104 USART3_Handler (USART3)
105 USART3_TxComplete_Handler (USART3)
106 USART4_Handler (USART4)
107 USART4_TxComplete_Handler (USART4)
108 SPI2_Handler (SPI2)
109 SPI3_Handler (SPI3)
110 EMB_GR0_Handler (EMB0)
111 EMB_GR1_Handler (EMB1)
112 EMB_GR2_Handler (EMB2)
113 EMB_GR3_Handler (EMB3)
114 USART5_Handler (USART5)
115 USART5_TxComplete_Handler (USART5)
115 USART6_Handler (USART6)
117 USART6_TxComplete_Handler (USART6)
118 MCAN1_INT0_Handler (MCAN1)
119 MCAN1_INT1_Handler (MCAN1)
120 MCAN2_INT0_Handler (MCAN2)
121 MCAN2_INT1_Handler (MCAN2)
122 USART1_WKUP_Handler (USART1)
123 PWC_LVD1_Handler (PWC)
124 PWC_LVD2_Handler (PWC)
125 FCM_Handler (FCM)
126 WDT_Handler (WDT)
127 CTC_Handler (CTC)
128 ADC1_Handler (ADC1)
129 ADC2_Handler (ADC2)
130 ADC3_Handler (ADC3)
131 TRNG_Handler (TRNG)
